## Kconfig
```kconfig
menu "TarableSSD1306"

config SSD1306_ENABLE_DEFAULT_I2C_INTERFACE
    bool "Enable default i2c master interface code"
    default y
    help
        Provides initialization code for both the i2c bus and i2c display device.

config SSD1306_DEFAULT_I2C_SPEED
    depends on SSD1306_ENABLE_DEFAULT_I2C_INTERFACE
    int "Bus speed for i2c master"
    default 250000
    help
        Default i2c interface speed in Hz

config SSD1306_DEFAULT_I2C_PORT_NUMBER
    depends on SSD1306_ENABLE_DEFAULT_I2C_INTERFACE
    int "I2C port number to use"
    default 0

config SSD1306_DEFAULT_I2C_SCL_PIN
    depends on SSD1306_ENABLE_DEFAULT_I2C_INTERFACE
    int "Default SCL pin number"
    default 22

config SSD1306_DEFAULT_I2C_SDA_PIN
    depends on SSD1306_ENABLE_DEFAULT_I2C_INTERFACE
    int "Default SDA pin number"
    default 21

config SSD1306_ENABLE_DEFAULT_SPI_INTERFACE
    bool "Enable default SPI interface"
    default y
    help
        Provides initialization code for both the i2c device and spi attached display.

config SSD1306_DEFAULT_SPI_HOST
    depends on SSD1306_ENABLE_DEFAULT_SPI_INTERFACE
    int
    default 1 if SSD1306_USE_HSPI_HOST
    default 2 if SSD1306_USE_VSPI_HOST

    choice
        depends on SSD1306_ENABLE_DEFAULT_SPI_INTERFACE
        prompt "Default SPI host"
        default SSD1306_USE_HSPI_HOST

        config SSD1306_USE_HSPI_HOST
            bool "HSPI"

        config SSD1306_USE_VSPI_HOST
            bool "VSPI"
    endchoice

config SSD1306_DEFAULT_SPI_FREQUENCY
    depends on SSD1306_ENABLE_DEFAULT_SPI_INTERFACE
    int "Default frequency for SPI attached display"
    default 1000000

config SSD1306_DEFAULT_SPI_MOSI_PIN
    depends on SSD1306_ENABLE_DEFAULT_SPI_INTERFACE
    int "Default MOSI pin number"
    default 13

config SSD1306_DEFAULT_SPI_SCLK_PIN
    depends on SSD1306_ENABLE_DEFAULT_SPI_INTERFACE
    int "Default SCLK pin number"
    default 14

config SSD1306_DEFAULT_SPI_DC_PIN
    depends on SSD1306_ENABLE_DEFAULT_SPI_INTERFACE
    int "Default DC pin number"
    default 33

config SSD1306_ERROR_ABORT
    bool "Call abort() on all errors"
    default y

config SSD1306_CLIPDEBUG
    int
    default 0 if CLIPDEBUG_NONE
    default 1 if CLIPDEBUG_WARNING
    default 2 if CLIPDEBUG_ERROR

    choice
        prompt "Clipping debug level"
        default CLIPDEBUG_WARNING

        
        config CLIPDEBUG_NONE
            bool "None"
        help
            Drawing operations clip silently.

        config CLIPDEBUG_WARNING
            bool "Warning"
        help
            If a drawing operation is clipped a warning is written to the console.

        config CLIPDEBUG_ERROR
            bool "Error"
        help
            If a drawing operation is clipped an error is written to the console along with an abort.
    endchoice

endmenu
```
